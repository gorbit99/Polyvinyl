## components/vqf/Kconfig
```kconfig
menu "VQF"

config USE_SINGLE_PRECISION
    bool "Use Single Precision Floats"
    default y
    help
        If set, VQF will use single instead of double precision floating point math

config NO_MOTION_BIAS_ESTIMATION
    bool "Disable Motion Bias Estimation"
    default n
    help
        Disables the motion bias estimation (MBE) feature of VQF

endmenu
```

## main/Kconfig.projbuild
```kconfig
rsource "networking/Kconfig.networking"
rsource "config/Kconfig.config"
rsource "sensors/Kconfig.sensors"
rsource "interfaces/Kconfig.interfaces"
```

## main/config/Kconfig.config
```kconfig
menu "Configuration"

    choice BOARD_TYPE
        prompt "Board Type"
        help 
            The type of the board in the tracker

        config BOARD_UNKNOWN
            bool "Unknown"

        config BOARD_SLIMEVR_LEGACY
            bool "SlimeVR Legacy"

        config BOARD_SLIMEVR_DEV
            bool "SlimeVR Dev"

        config BOARD_NODEMCU
            bool "NodeMcu"

        config BOARD_CUSTOM
            bool "Custom"

        config BOARD_WROOM32
            bool "WROOM32"

        config BOARD_WEMOS_D1_MINI
            bool "WEMOS D1 Mini"

        config BOARD_TTGO_TBASE
            bool "TTGO T-Base"

        config BOARD_ESP01
            bool "ESP-01"

        config BOARD_SLIMEVR
            bool "SlimeVR"

        config BOARD_LOLIN_C3_MINI
            bool "Lolin C3 Mini"

        config BOARD_BEETLE32C3
            bool "Beetle32-C3"

        config BOARD_ESP32C3_DEVKIT_M1
            bool "ESP32-C3 DevKit M1"

        config BOARD_WEMOS_WROOM_02
            bool "WEMOS WROOM-02"

        config BOARD_XIAO_ESP32C3
            bool "Xiao ESP32-C3"

        config BOARD_ESP32C6_DEVKIT_C1
            bool "ESP32-C6 DevKit C1"

        config BOARD_GLOVE_IMU_SLIMEVR_DEV
            bool "SlimeVR IMU Glove Dev"

        config BOARD_SLIMEVR_V1_2
            bool "SlimeVR V1.2"

        config BOARD_ESP32S3_SUPERMINI
            bool "ESP32-S3 Supermini"

    endchoice

    choice MCU_TYPE
        prompt "MCU Type"

        config MCU_UNKNOWN
            bool "Unknown"

        config MCU_ESP8266
            bool "ESP8266"

        config MCU_ESP32
            bool "ESP32"

        config MCU_ESP32C3
            bool "ESP32-C3"
    endchoice

endmenu
```

## main/interfaces/Kconfig.interfaces
```kconfig
menu "Interfaces"

    choice I2C_FREQUENCY
        prompt "I2C Frequency"
        default I2C_FREQUENCY_400K
        help
            The frequency of the I2C communications

        config I2C_FREQUENCY_100K
            bool "100kHz"
        
        config I2C_FREQUENCY_400K
            bool "400KHz"

    endchoice

endmenu
```

## main/networking/Kconfig.networking
```kconfig
menu "Networking"

    config HARDCODED_SSID
        string "Hardcoded SSID"
        help
            The harcoded (fallback) value for the Wi-Fi SSID
    
    config HARDCODED_PASSWORD
        string "Hardcoded Password"
        help
            The harcoded (fallback) value for the Wi-Fi password

    config WIFI_CONNECTION_RETRY_COUNT
        int "Wi-Fi Connection Retry Attempts"
        default 1
        help
            How many times the tracker should retry while connecting to the Wi-Fi

    config SERVER_DISCOVERY_RATE_SECONDS
        int "Server Discovery Send Rate (in seconds)"
        default 2
        help
            When not connected, how often the tracker should try to look for the server

    config SENSOR_INFO_RATE_SECONDS
        int "Sensor Info Send Rate (in seconds)"
        default 1
        help
            How often the Sensor Info packet should be sent to the server

    config SENSOR_DATA_RATE_HZ
        int "Sensor Data Send Rate (in Hz)"
        default 100
        help
            How often sensor rotation and acceleration updates should be sent to the server

    config TRACKER_RSSI_RATE_SECONDS
        int "RSSI (Signal Strength) Send Rate (in seconds)"
        default 2
        help
            How often the tracker should send rssi information to the server

    config SENSOR_TEMPERATURE_RATE_HZ
        int "Sensor Temperature Send Rate (in Hz)"
        default 2
        help
            How often the tracker should send sensor Temperature information to the server

endmenu
```

## main/peripherals/Kconfig.peripherals
```kconfig
menu "Peripherals"

    menu "Battery"

        config BATTERY_SHIELD_RESISTANCE
            int "Battery Shield Resistance (in ohm)"
            default 0
            help
                If using a module with a designated analogue pin (D1 mini), this is the single 
                resistor you add in addition to the ones on the board, otherwise leave at 0

        config BATTERY_DIVIDER_R1
            int "Battery Voltage Divider R1 (in ohm)"
            default 100000
            help
                The value of the resistor between the positive battery terminal and the battery pin

        config BATTERY_DIVIDER_R2
            int "Battery Voltage Divider R2 (in ohm)"
            default 100000
            help
                The value of the resistor between the negative battery terminal (ground) and the battery pin

        config BATTERY_READ_RATE_SECONDS
            int "Battery Status Read Rate (in seconds)"
            default 10
            help
                How often the battery's charge level should be read

        config BATTERY_PIN
            int "Battery ADC pin"
            range 0 255
            default 3
            help
                Which pin the battery voltage sense is attached to

    endmenu
    
endmenu
```

## main/sensors/Kconfig.sensors
```kconfig
menu "Sensors"

    config SCL_PIN
        int "SCL Pin"
        range 0 255
        help
            The pin the SCL line of the I2C bus is attached to

    config SDA_PIN
        int "SDA Pin"
        range 0 255
        help
            The pin the SDA line of the I2C bus is attached to

    rsource "drivers/Kconfig.drivers"

endmenu
```

## main/sensors/drivers/Kconfig.icm45686
```kconfig
menu "ICM45686"

    config ICM45686_ENABLE_CLOCK
        bool "Enable Clock"
        default y
        help
            Enables the clock feature of the ICM-45686 to improve its sensitivity.
            Disabling this will significantly worsen some aspects of the sensor.

    choice ICM45686_GYRO_ODR
        prompt "ICM-45686 Gyro ODR (Hz)"
        help
            The output data rate of the ICM-45686 gyro sensor
        default ICM45686_GYRO_ODR_400

        config ICM45686_GYRO_ODR_6400
            bool "6.4kHz"

        config ICM45686_GYRO_ODR_3200
            bool "3.2kHz"

        config ICM45686_GYRO_ODR_1600
            bool "1.6kHz"

        config ICM45686_GYRO_ODR_800
            bool "800Hz"

        config ICM45686_GYRO_ODR_400
            bool "400Hz"

        config ICM45686_GYRO_ODR_200
            bool "200Hz"

        config ICM45686_GYRO_ODR_100
            bool "100Hz"

        config ICM45686_GYRO_ODR_50
            bool "50Hz"

        config ICM45686_GYRO_ODR_25
            bool "25Hz"

        config ICM45686_GYRO_ODR_12_5
            bool "12.5Hz"

        config ICM45686_GYRO_ODR_6_25
            bool "6.25Hz"

        config ICM45686_GYRO_ODR_3_125
            bool "3.125Hz"

        config ICM45686_GYRO_ODR_1_5625
            bool "1.5625Hz"

    endchoice

    choice ICM45686_ACCEL_ODR
        prompt "ICM-45686 Accel ODR (Hz)"
        help
            The output data rate of the ICM-45686 accel sensor
        default ICM45686_ACCEL_ODR_100

        config ICM45686_ACCEL_ODR_6400
            bool "6.4kHz"

        config ICM45686_ACCEL_ODR_3200
            bool "3.2kHz"

        config ICM45686_ACCEL_ODR_1600
            bool "1.6kHz"

        config ICM45686_ACCEL_ODR_800
            bool "800Hz"

        config ICM45686_ACCEL_ODR_400
            bool "400Hz"

        config ICM45686_ACCEL_ODR_200
            bool "200Hz"

        config ICM45686_ACCEL_ODR_100
            bool "100Hz"

        config ICM45686_ACCEL_ODR_50
            bool "50Hz"

        config ICM45686_ACCEL_ODR_25
            bool "25Hz"

        config ICM45686_ACCEL_ODR_12_5
            bool "12.5Hz"

        config ICM45686_ACCEL_ODR_6_25
            bool "6.25Hz"

        config ICM45686_ACCEL_ODR_3_125
            bool "3.125Hz"

        config ICM45686_ACCEL_ODR_1_5625
            bool "1.5625Hz"

    endchoice

endmenu
```
